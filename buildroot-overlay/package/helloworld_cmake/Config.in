## buildroot-overlay/package/helloworld_cmake/Config.in
```kconfig
config BR2_PACKAGE_HELLOWORLD_CMAKE
    bool "helloworld cmake"
    select BR2_PACKAGE_LIBPNG
    help
      A simple "Hello, World!" program built with CMake.
```

## buildroot-overlay/package/k230-status-ready/Config.in
```kconfig
config BR2_PACKAGE_K230_STATUS_READY
	bool "Cyberdeck K230 status ready service"
	help
	  Installs a small helper and startup integration that writes 1 to the
	  cyberdeck,k230-status platform driver's ready sysfs attribute.
```
